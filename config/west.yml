## config/west.yml
```yaml
manifest:
  remotes:
    - name: paulhjyoon
      url-base: https://github.com/paulhjyoon
  projects:
    - name: zmk
      remote: paulhjyoon
      revision: main
      import: app/west.yml
  self:
    path: config
```
